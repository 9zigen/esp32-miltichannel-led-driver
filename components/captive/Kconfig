## components/captive/Kconfig
```kconfig
menu "Captive DNS redirect"

config CAPTIVE_REDIRECT_IP
    string "Redirect IP Address"
	default "192.168.4.1"

endmenu
```

## components/ota/Kconfig
```kconfig
menu "OTA"

config OTA_URL
    string "OTA URL"
	default "http://192.168.4.2:8070/hv_cc_led_driver_rtos.ota.bin"
	help
		HTTP Server url to download the image file from.

		See example README.md for details.

endmenu
```

## main/Kconfig.projbuild
```kconfig
menu "LED Controller Configuration"

config CONTROLLER_WIFI_SSID
    string "AP WiFi SSID"
    default "LED_CONTROLLER"
    help
        SSID (network name) for the example to connect to.

config CONTROLLER_WIFI_PASS
    string "AP WiFi Password"
    default "12345678"
    help
        WiFi password (WPA or WPA2) for the example to use.
        Can be left blank if the network has no security set.

config CONTROLLER_WIFI_CHANNEL
    int "WiFi Channel"
    range 1 13
    default 1
    help
        WiFi SoftAp channel (network channel).

config CONTROLLER_LED_STATUS
    int "Board Status Led Pin"
    default 1
    help
        Status Led Pin Number

endmenu
```

## sdkconfig.defaults
```kconfig
CONFIG_ESPTOOLPY_FLASHSIZE_4MB=y
CONFIG_PARTITION_TABLE_CUSTOM=y
CONFIG_PARTITION_TABLE_CUSTOM_FILENAME="partitions.csv"
CONFIG_PARTITION_TABLE_FILENAME="partitions.csv"
CONFIG_PARTITION_TABLE_OFFSET=0x8000
CONFIG_PARTITION_TABLE_MD5=y
CONFIG_NEWLIB_LIBRARY_LEVEL_NORMAL=y
CONFIG_MBEDTLS_SSL_OUT_CONTENT_LEN=2048
CONFIG_MBEDTLS_SSL_IN_CONTENT_LEN=4096
CONFIG_ESPTOOLPY_FLASHFREQ_80M=y
CONFIG_ESPTOOLPY_FLASHFREQ="80m"
CONFIG_COMPILER_OPTIMIZATION_SIZE=y
CONFIG_OPTIMIZATION_LEVEL_RELEASE=y
CONFIG_COMPILER_OPTIMIZATION_LEVEL_RELEASE=y
CONFIG_FREERTOS_OPTIMIZED_SCHEDULER=y
CONFIG_FREERTOS_IDLE_TASK_STACKSIZE=2304
CONFIG_TIMER_TASK_STACK_DEPTH=3072
CONFIG_FREERTOS_TIMER_TASK_STACK_DEPTH=3072
CONFIG_ESP_SYSTEM_SINGLE_CORE_MODE=y
CONFIG_ESP_SYSTEM_RTC_FAST_MEM_AS_HEAP_DEPCHECK=y
CONFIG_ESP_SYSTEM_ALLOW_RTC_FAST_MEM_AS_HEAP=y
CONFIG_ESP_HTTPS_OTA_ALLOW_HTTP=y
CONFIG_OTA_ALLOW_HTTP=y
CONFIG_HTTPD_MAX_REQ_HDR_LEN=1024
CONFIG_HTTPD_MAX_URI_LEN=1024
CONFIG_HTTPD_WS_SUPPORT=y

# TODO Optimise this
CONFIG_ESP_SYSTEM_SINGLE_CORE_MODE=y
CONFIG_ESP_SYSTEM_RTC_FAST_MEM_AS_HEAP_DEPCHECK=y
CONFIG_ESP_SYSTEM_ALLOW_RTC_FAST_MEM_AS_HEAP=y
CONFIG_REDUCE_PHY_TX_POWER=y
CONFIG_ESP32_REDUCE_PHY_TX_POWER=y
CONFIG_ESP32_ALLOW_RTC_FAST_MEM_AS_HEAP=y
```
